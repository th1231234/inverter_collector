## main/Kconfig.projbuild
```kconfig
menu "Inverter Collector"

    menu "Wi-Fi 参数"
        config WIFI_SSID
            string "路由器 SSID"
            default "YOUR_SSID"
            help
                要连接的 Wi-Fi 名称。验收时填公司路由器名称（由导师提供）。

        config WIFI_PASSWORD
            string "路由器密码"
            default "YOUR_PASSWORD"
            help
                要连接的 Wi-Fi 密码。验收时填公司路由器密码（由导师提供）。
    endmenu

    menu "上报通道"
        choice REPORT_PROTO
            prompt "上报协议"
            default REPORT_PROTO_UDP
            help
                UDP：无连接，一次 sendto 对应一条消息，接收端无需 accept。
                     与测验文档「通过 UDP 发送 JSON 格式数据」一致，为默认选项。
                TCP：需先 connect 建立连接，接收端需 listen/accept。
                     与文档标题「TCP服务器IP」一致。注意 TCP 是字节流，
                     消息之间以换行符 '\n' 分隔，接收端需按行切分。
                MQTT：发布/订阅模型，需要 Broker 转发。适合多设备接入、
                     断线自动重连的场景，是工业物联网更常见的做法。

            config REPORT_PROTO_UDP
                bool "UDP（默认，符合功能要求）"

            config REPORT_PROTO_TCP
                bool "TCP（对应文档标题中的 TCP服务器IP）"

            config REPORT_PROTO_MQTT
                bool "MQTT（发布到 Broker，额外能力）"
        endchoice

        config REPORT_TARGET_IP
            string "上报目标 IP（仅 UDP/TCP）"
            default "192.168.1.200"
            help
                接收端所在电脑的 IP，只有 UDP / TCP 通道会用到。
                自测可用电脑热点网关（通常 192.168.137.1）。

        config REPORT_TARGET_PORT
            int "上报目标端口（仅 UDP/TCP）"
            range 1 65535
            default 8080
            help
                接收端监听的端口，默认 8080，只有 UDP / TCP 通道会用到。

        config MQTT_BROKER_URI
            string "MQTT Broker 地址（URI）"
            depends on REPORT_PROTO_MQTT
            default "mqtt://broker.emqx.io:1883"
            help
                格式为 协议://主机:端口。
                  公共测试服务器：mqtt://broker.emqx.io:1883
                  本地 mosquitto：mqtt://192.168.1.100:1883
                  加密连接：mqtts://主机:8883（还需配置证书）

        config MQTT_DEV_ID
            string "设备工号（拼主题与 Client ID）"
            depends on REPORT_PROTO_MQTT
            default "intern01"
            help
                四个主题由工号在编译期拼成（指导书 2.3 约定的 dev/<工号>/用途）：

                  dev/<工号>/read    下行  查询寄存器（功能码 03）
                  dev/<工号>/write   下行  修改寄存器（功能码 06）
                  dev/<工号>/resp    上行  应答，每个请求必回一条
                  dev/<工号>/data    上行  周期上报，每 5 秒一条

                MQTT Client ID 也直接用工号。同一 Broker 上工号不能重复，
                重复会互相踢下线。验收时换成真实工号。

        config MQTT_USERNAME
            string "MQTT 用户名（留空为匿名）"
            depends on REPORT_PROTO_MQTT
            default ""
            help
                broker.emqx.io 等公共测试服务器支持匿名，留空即可。

        config MQTT_PASSWORD
            string "MQTT 密码（留空为匿名）"
            depends on REPORT_PROTO_MQTT
            default ""
    endmenu

    menu "调试选项"
        config MODBUS_SELFTEST
            bool "启动时运行 Modbus 功能码自检"
            default n
            help
                开启后，app_main 在 Modbus 初始化完成、启动采集任务之前，
                先依次测试以下内容并把结果打到日志：

                  03 读保持寄存器
                  06 写单寄存器 + 回读校验
                  16 写多寄存器 + 回读校验
                  04 读输入寄存器
                  01 读线圈
                  02 读离散输入
                  越界地址的异常应答

                其中 04/01/02 需要把 Modbus Slave 窗口的 Function
                切换到对应类型，否则会超时，属预期现象。
                自检约耗时 3~6 秒，跑完自动进入正常采集。

                仅用于训练与调试，交付版本请保持关闭。
    endmenu

endmenu
```

## sdkconfig.defaults
```kconfig
# ==================================================================
# 默认配置模板：首次编译或重新生成 sdkconfig 时自动套用
# ------------------------------------------------------------------
# sdkconfig 本身已加入 .gitignore（避免真实 Wi-Fi 凭据进入公开仓库），
# 因此这里只放与硬件相关的固定项 + 占位符。
#
# 实际网络参数请在项目目录执行：
#     idf.py menuconfig
#   → Inverter Collector → Wi-Fi 参数 / 上报通道
# 保存后生成你自己的 sdkconfig，不会被提交。
# ==================================================================

# 目标芯片
CONFIG_IDF_TARGET="esp32c3"

# Flash 容量 4MB，单 app 分区
CONFIG_ESPTOOLPY_FLASHSIZE_4MB=y
CONFIG_ESPTOOLPY_FLASHSIZE="4MB"

# ---- Wi-Fi 参数（占位符，必须改成真实值）----
CONFIG_WIFI_SSID="YOUR_SSID"
CONFIG_WIFI_PASSWORD="YOUR_PASSWORD"

# ---- 上报通道 ----
# 默认 UDP（符合测验功能要求）；选 TCP 时改用 tcp.c
CONFIG_REPORT_PROTO_UDP=y
CONFIG_REPORT_TARGET_IP="192.168.1.200"
CONFIG_REPORT_TARGET_PORT=8080

# ---- MQTT（阶段二）----
# 阶段二使用 MQTT 时，把上面的 CONFIG_REPORT_PROTO_UDP=y 换成：
#   CONFIG_REPORT_PROTO_MQTT=y
# 下面几项在选中 MQTT 后才生效。密码留空，由本机 sdkconfig 填写。
# 工号决定四个主题 dev/<工号>/{read,write,resp,data} 与 Client ID，
# 同一 Broker 上不能重复。
CONFIG_MQTT_BROKER_URI="mqtt://192.168.137.1:1883"
CONFIG_MQTT_DEV_ID="intern01"
CONFIG_MQTT_USERNAME="esp32"
CONFIG_MQTT_PASSWORD=""
```
